## components/led_WS2812/Kconfig
```kconfig
menu "My LED Configuration"

    choice BLINK_LED_TYPE
        prompt "Blink LED Type"
        default BLINK_LED_GPIO
        help
            Select the LED type. A normal level controlled LED or an addressable LED strip.

        config BLINK_LED_GPIO
            bool "GPIO"
        config BLINK_LED_STRIP
            bool "LED strip"
    endchoice

    choice BLINK_LED_STRIP_BACKEND
        depends on BLINK_LED_STRIP
        prompt "LED strip backend peripheral"
        default BLINK_LED_STRIP_BACKEND_RMT
        help
            Select the backend peripheral to drive the LED strip.

        config BLINK_LED_STRIP_BACKEND_RMT
            bool "RMT"
        config BLINK_LED_STRIP_BACKEND_SPI
            bool "SPI"
    endchoice

    config BLINK_GPIO
        int "Blink GPIO number"
        range 0 48
        default 8
        help
            GPIO number (0-48) to blink on and off the LED.

    config BLINK_PERIOD
        int "Blink period in ms"
        range 10 3600000
        default 1000
        help
            Define the blinking period in milliseconds.

endmenu
```

## components/mqtt_component/Kconfig
```kconfig
menu "MQTT Configuration"

    config MQTT_BROKER_URI
        string "MQTT Broker URI"
        default "mqtt://broker.emqx.io:1883"
        help
            URI of the MQTT broker to connect to.
            Format: mqtt://broker_host:port or mqtts://broker_host:port for SSL
            Examples:
            - mqtt://broker.emqx.io:1883
            - mqtts://broker.emqx.io:8884
            - mqtt://192.168.1.100:1883

    config MQTT_KEEPALIVE
        int "MQTT Keep Alive interval (seconds)"
        default 60
        range 10 300
        help
            Keep-alive interval for MQTT connection

endmenu
```

## components/wifi_component/Kconfig
```kconfig
menu "Wi-Fi Component Configuration"

    config WIFI_COMPONENT_STA_SSID
        string "Wi-Fi STA SSID"
        default ""
        help
            Target SSID for station mode. Keep empty to disable STA when using defaults.

    config WIFI_COMPONENT_STA_PASS
        string "Wi-Fi STA Password"
        default ""
        help
            Target password for station mode.

    config WIFI_COMPONENT_AP_SSID
        string "Wi-Fi AP SSID"
        default "my-device-kozariz"
        help
            SoftAP SSID.

    config WIFI_COMPONENT_AP_PASS
        string "Wi-Fi AP Password"
        default "12345678"
        help
            SoftAP password. Use at least 8 chars for WPA2, or leave empty for open AP.

endmenu
```
